#include "LedMatrix.h"


u8 colScan[8] = {0xFE, 0xFD, 0xFB, 0xF7, 0xEF, 0xDF, 0xBF, 0x7F};

u8 Matrix_Pattern = 0;

static u8 row = 0x00;
static u8 col = 0xFE;
static u8 i = 0;
static u8 n = 0;

u8 scanTime = 0;

u8 Char = 0;




void delay_speed(u32 speed);


u8 character[27][8] = {
	{0x00,0x00,0x00,0x00,0x00,0x00,0x00,0x00},
	{0x00,0xFC,0x0E,0x09,0x09,0x0E,0xFC,0x00}, // A
	{0x00,0xff,0xff,0x99,0x99,0x99,0x66,0x00}, // B
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	{0x81,0xc1,0xa1,0x91,0x89,0x85,0x83,0x81}, // Z
};

const u8 temp_character[27][8] = 
{
	{0x00,0x00,0x00,0x00,0x00,0x00,0x00,0x00},
	{0x00,0xFC,0x0E,0x09,0x09,0x0E,0xFC,0x00}, // A
	{0x00,0xff,0xff,0x99,0x99,0x99,0x66,0x00}, // B
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	{0x81,0xc1,0xa1,0x91,0x89,0x85,0x83,0x81}, // Z
};
	
static  u8 ShiftLed[8] = {0x00, 0x00, 0x00, 0x00, 0x00, 0x00, 0x00, 0x00};
	
void LedMatrix_Pin_Init()
{
	DDRx(0xFF, DDRF, OUTPUT);
	DDRx(0xFF, DDRK, OUTPUT);
	PORTF = 0x00;
	PORTK = 0xFF;
}

void Scan_LedMatrix()
{
	PORTF = character[Char][i];
	PORTK = colScan[i];	
	i++;
	if(i > 7) i = 0;
}

void Display_Character(char c)
{
	Char = (u8)c - 64;
}

void Display_String(char *str)
{
	
}

void Shift_LedMatrix(u8 mode, u32 speed)
{
	if(mode == LEFT)
	{
		ShiftLeft(speed);
	}
	else
	{
		ShiftRight(speed);
	}
}

void Refresh()
{

}

void ShiftLeft(u32 speed)
{
	u32 temp = speed;

	for(u8 i = 0; i < 8; i++)
	{
		ShiftLed[i] = temp_character[Char][i];
	}
	for(u8 k = 0; k < 8; k++)
	{
		for(u8 i = 0; i < 7; i++)
		{
			ShiftLed[i] = ShiftLed[i+1];
		}
		ShiftLed[7] = temp_character[Char][k];
		for(u8 i = 0; i < 8;)
		{
			temp--;
			_delay_ms(1);
			if(temp <= 0)
			{
				temp = speed;
				character[Char][i] = ShiftLed[i];
				i++;
			}
		}
		//character[Char][7] = temp_character[Char][k];
	}	
}

void ShiftRight(u32 speed)
{
	u32 temp = speed;
	for(u8 i = 0; i < 8; i++)
	{
		ShiftLed[i] = temp_character[Char][i];
	}
	for(u8 k = 8; k > 0; k--)
	{
		for(u8 i = 7; i > 0; i--)
		{
			ShiftLed[i] = ShiftLed[i-1];
		}
		ShiftLed[0] = temp_character[Char][k-1];
		for(u8 i = 7; i > 0;)
		{
			temp--;
			_delay_ms(1);
			if(temp <= 0)
			{
				temp = speed;
				character[Char][i] = ShiftLed[i];
				i--;
			}				
		}
		character[Char][0] = temp_character[Char][k-1];			
	}	
}

